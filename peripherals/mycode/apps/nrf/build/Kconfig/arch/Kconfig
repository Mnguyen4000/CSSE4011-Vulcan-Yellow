## peripherals/mycode/apps/nrf/build/Kconfig/arch/Kconfig
```kconfig
# Load arch Kconfig descriptions.
osource "/home/mnguyen4000/CSSE4011-Vulcan-Yellow/peripherals/zephyr/arch/x86/Kconfig"
osource "/home/mnguyen4000/CSSE4011-Vulcan-Yellow/peripherals/zephyr/arch/xtensa/Kconfig"
osource "/home/mnguyen4000/CSSE4011-Vulcan-Yellow/peripherals/zephyr/arch/sparc/Kconfig"
osource "/home/mnguyen4000/CSSE4011-Vulcan-Yellow/peripherals/zephyr/arch/riscv/Kconfig"
osource "/home/mnguyen4000/CSSE4011-Vulcan-Yellow/peripherals/zephyr/arch/posix/Kconfig"
osource "/home/mnguyen4000/CSSE4011-Vulcan-Yellow/peripherals/zephyr/arch/nios2/Kconfig"
osource "/home/mnguyen4000/CSSE4011-Vulcan-Yellow/peripherals/zephyr/arch/mips/Kconfig"
osource "/home/mnguyen4000/CSSE4011-Vulcan-Yellow/peripherals/zephyr/arch/arm64/Kconfig"
osource "/home/mnguyen4000/CSSE4011-Vulcan-Yellow/peripherals/zephyr/arch/arm/Kconfig"
osource "/home/mnguyen4000/CSSE4011-Vulcan-Yellow/peripherals/zephyr/arch/arc/Kconfig"
```

## peripherals/mycode/apps/nrf/build/Kconfig/soc/Kconfig
```kconfig
# Load Zephyr SoC Kconfig descriptions.
osource "/home/mnguyen4000/CSSE4011-Vulcan-Yellow/peripherals/zephyr/soc/xlnx/zynqmp/Kconfig"
osource "/home/mnguyen4000/CSSE4011-Vulcan-Yellow/peripherals/zephyr/soc/xlnx/zynq7000/Kconfig"
osource "/home/mnguyen4000/CSSE4011-Vulcan-Yellow/peripherals/zephyr/soc/xen/Kconfig"
osource "/home/mnguyen4000/CSSE4011-Vulcan-Yellow/peripherals/zephyr/soc/ti/simplelink/Kconfig"
osource "/home/mnguyen4000/CSSE4011-Vulcan-Yellow/peripherals/zephyr/soc/ti/lm3s6965/Kconfig"
osource "/home/mnguyen4000/CSSE4011-Vulcan-Yellow/peripherals/zephyr/soc/ti/k3/Kconfig"
osource "/home/mnguyen4000/CSSE4011-Vulcan-Yellow/peripherals/zephyr/soc/telink/tlsr/Kconfig"
osource "/home/mnguyen4000/CSSE4011-Vulcan-Yellow/peripherals/zephyr/soc/starfive/jh71xx/Kconfig"
osource "/home/mnguyen4000/CSSE4011-Vulcan-Yellow/peripherals/zephyr/soc/st/stm32/Kconfig"
osource "/home/mnguyen4000/CSSE4011-Vulcan-Yellow/peripherals/zephyr/soc/snps/qemu_arc/Kconfig"
osource "/home/mnguyen4000/CSSE4011-Vulcan-Yellow/peripherals/zephyr/soc/snps/nsim/Kconfig"
osource "/home/mnguyen4000/CSSE4011-Vulcan-Yellow/peripherals/zephyr/soc/snps/hsdk4xd/Kconfig"
osource "/home/mnguyen4000/CSSE4011-Vulcan-Yellow/peripherals/zephyr/soc/snps/hsdk/Kconfig"
osource "/home/mnguyen4000/CSSE4011-Vulcan-Yellow/peripherals/zephyr/soc/snps/emsk/Kconfig"
osource "/home/mnguyen4000/CSSE4011-Vulcan-Yellow/peripherals/zephyr/soc/snps/emsdp/Kconfig"
osource "/home/mnguyen4000/CSSE4011-Vulcan-Yellow/peripherals/zephyr/soc/snps/arc_iot/Kconfig"
osource "/home/mnguyen4000/CSSE4011-Vulcan-Yellow/peripherals/zephyr/soc/silabs/Kconfig"
osource "/home/mnguyen4000/CSSE4011-Vulcan-Yellow/peripherals/zephyr/soc/sifive/sifive_freedom/Kconfig"
osource "/home/mnguyen4000/CSSE4011-Vulcan-Yellow/peripherals/zephyr/soc/rockchip/Kconfig"
osource "/home/mnguyen4000/CSSE4011-Vulcan-Yellow/peripherals/zephyr/soc/renode/riscv_virtual/Kconfig"
osource "/home/mnguyen4000/CSSE4011-Vulcan-Yellow/peripherals/zephyr/soc/renesas/smartbond/Kconfig"
osource "/home/mnguyen4000/CSSE4011-Vulcan-Yellow/peripherals/zephyr/soc/renesas/rzt2m/Kconfig"
osource "/home/mnguyen4000/CSSE4011-Vulcan-Yellow/peripherals/zephyr/soc/renesas/rcar/Kconfig"
osource "/home/mnguyen4000/CSSE4011-Vulcan-Yellow/peripherals/zephyr/soc/renesas/ra/Kconfig"
osource "/home/mnguyen4000/CSSE4011-Vulcan-Yellow/peripherals/zephyr/soc/raspberrypi/Kconfig"
osource "/home/mnguyen4000/CSSE4011-Vulcan-Yellow/peripherals/zephyr/soc/quicklogic/eos_s3/Kconfig"
osource "/home/mnguyen4000/CSSE4011-Vulcan-Yellow/peripherals/zephyr/soc/qemu/virt_riscv/Kconfig"
osource "/home/mnguyen4000/CSSE4011-Vulcan-Yellow/peripherals/zephyr/soc/qemu/malta/Kconfig"
osource "/home/mnguyen4000/CSSE4011-Vulcan-Yellow/peripherals/zephyr/soc/openisa/rv32m1/Kconfig"
osource "/home/mnguyen4000/CSSE4011-Vulcan-Yellow/peripherals/zephyr/soc/nxp/s32/Kconfig"
osource "/home/mnguyen4000/CSSE4011-Vulcan-Yellow/peripherals/zephyr/soc/nxp/rw/Kconfig"
osource "/home/mnguyen4000/CSSE4011-Vulcan-Yellow/peripherals/zephyr/soc/nxp/mcx/Kconfig"
osource "/home/mnguyen4000/CSSE4011-Vulcan-Yellow/peripherals/zephyr/soc/nxp/lpc/Kconfig"
osource "/home/mnguyen4000/CSSE4011-Vulcan-Yellow/peripherals/zephyr/soc/nxp/layerscape/Kconfig"
osource "/home/mnguyen4000/CSSE4011-Vulcan-Yellow/peripherals/zephyr/soc/nxp/kinetis/Kconfig"
osource "/home/mnguyen4000/CSSE4011-Vulcan-Yellow/peripherals/zephyr/soc/nxp/imxrt/Kconfig"
osource "/home/mnguyen4000/CSSE4011-Vulcan-Yellow/peripherals/zephyr/soc/nxp/imx/Kconfig"
osource "/home/mnguyen4000/CSSE4011-Vulcan-Yellow/peripherals/zephyr/soc/nuvoton/numicro/Kconfig"
osource "/home/mnguyen4000/CSSE4011-Vulcan-Yellow/peripherals/zephyr/soc/nuvoton/numaker/Kconfig"
osource "/home/mnguyen4000/CSSE4011-Vulcan-Yellow/peripherals/zephyr/soc/nuvoton/npcx/Kconfig"
osource "/home/mnguyen4000/CSSE4011-Vulcan-Yellow/peripherals/zephyr/soc/nordic/Kconfig"
osource "/home/mnguyen4000/CSSE4011-Vulcan-Yellow/peripherals/zephyr/soc/neorv32/Kconfig"
osource "/home/mnguyen4000/CSSE4011-Vulcan-Yellow/peripherals/zephyr/soc/native/inf_clock/Kconfig"
osource "/home/mnguyen4000/CSSE4011-Vulcan-Yellow/peripherals/zephyr/soc/microchip/miv/Kconfig"
osource "/home/mnguyen4000/CSSE4011-Vulcan-Yellow/peripherals/zephyr/soc/microchip/mec/Kconfig"
osource "/home/mnguyen4000/CSSE4011-Vulcan-Yellow/peripherals/zephyr/soc/lowrisc/opentitan/Kconfig"
osource "/home/mnguyen4000/CSSE4011-Vulcan-Yellow/peripherals/zephyr/soc/litex/litex_vexriscv/Kconfig"
osource "/home/mnguyen4000/CSSE4011-Vulcan-Yellow/peripherals/zephyr/soc/ite/ec/Kconfig"
osource "/home/mnguyen4000/CSSE4011-Vulcan-Yellow/peripherals/zephyr/soc/intel/raptor_lake/Kconfig"
osource "/home/mnguyen4000/CSSE4011-Vulcan-Yellow/peripherals/zephyr/soc/intel/lakemont/Kconfig"
osource "/home/mnguyen4000/CSSE4011-Vulcan-Yellow/peripherals/zephyr/soc/intel/intel_socfpga_std/Kconfig"
osource "/home/mnguyen4000/CSSE4011-Vulcan-Yellow/peripherals/zephyr/soc/intel/intel_socfpga/Kconfig"
osource "/home/mnguyen4000/CSSE4011-Vulcan-Yellow/peripherals/zephyr/soc/intel/intel_niosv/Kconfig"
osource "/home/mnguyen4000/CSSE4011-Vulcan-Yellow/peripherals/zephyr/soc/intel/intel_ish/Kconfig"
osource "/home/mnguyen4000/CSSE4011-Vulcan-Yellow/peripherals/zephyr/soc/intel/intel_adsp/Kconfig"
osource "/home/mnguyen4000/CSSE4011-Vulcan-Yellow/peripherals/zephyr/soc/intel/elkhart_lake/Kconfig"
osource "/home/mnguyen4000/CSSE4011-Vulcan-Yellow/peripherals/zephyr/soc/intel/atom/Kconfig"
osource "/home/mnguyen4000/CSSE4011-Vulcan-Yellow/peripherals/zephyr/soc/intel/apollo_lake/Kconfig"
osource "/home/mnguyen4000/CSSE4011-Vulcan-Yellow/peripherals/zephyr/soc/intel/alder_lake/Kconfig"
osource "/home/mnguyen4000/CSSE4011-Vulcan-Yellow/peripherals/zephyr/soc/infineon/xmc/Kconfig"
osource "/home/mnguyen4000/CSSE4011-Vulcan-Yellow/peripherals/zephyr/soc/gd/gd32/Kconfig"
osource "/home/mnguyen4000/CSSE4011-Vulcan-Yellow/peripherals/zephyr/soc/gaisler/leon3/Kconfig"
osource "/home/mnguyen4000/CSSE4011-Vulcan-Yellow/peripherals/zephyr/soc/gaisler/gr716a/Kconfig"
osource "/home/mnguyen4000/CSSE4011-Vulcan-Yellow/peripherals/zephyr/soc/espressif/Kconfig"
osource "/home/mnguyen4000/CSSE4011-Vulcan-Yellow/peripherals/zephyr/soc/ene/kb1200/Kconfig"
osource "/home/mnguyen4000/CSSE4011-Vulcan-Yellow/peripherals/zephyr/soc/efinix/sapphire/Kconfig"
osource "/home/mnguyen4000/CSSE4011-Vulcan-Yellow/peripherals/zephyr/soc/cypress/Kconfig"
osource "/home/mnguyen4000/CSSE4011-Vulcan-Yellow/peripherals/zephyr/soc/cdns/xtensa_sample_controller/Kconfig"
osource "/home/mnguyen4000/CSSE4011-Vulcan-Yellow/peripherals/zephyr/soc/cdns/dc233c/Kconfig"
osource "/home/mnguyen4000/CSSE4011-Vulcan-Yellow/peripherals/zephyr/soc/brcm/bcmvk/Kconfig"
osource "/home/mnguyen4000/CSSE4011-Vulcan-Yellow/peripherals/zephyr/soc/brcm/bcm2712/Kconfig"
osource "/home/mnguyen4000/CSSE4011-Vulcan-Yellow/peripherals/zephyr/soc/brcm/bcm2711/Kconfig"
osource "/home/mnguyen4000/CSSE4011-Vulcan-Yellow/peripherals/zephyr/soc/atmel/sam0/Kconfig"
osource "/home/mnguyen4000/CSSE4011-Vulcan-Yellow/peripherals/zephyr/soc/atmel/sam/Kconfig"
osource "/home/mnguyen4000/CSSE4011-Vulcan-Yellow/peripherals/zephyr/soc/aspeed/Kconfig"
osource "/home/mnguyen4000/CSSE4011-Vulcan-Yellow/peripherals/zephyr/soc/arm/Kconfig"
osource "/home/mnguyen4000/CSSE4011-Vulcan-Yellow/peripherals/zephyr/soc/arm/beetle/Kconfig"
osource "/home/mnguyen4000/CSSE4011-Vulcan-Yellow/peripherals/zephyr/soc/andestech/Kconfig"
osource "/home/mnguyen4000/CSSE4011-Vulcan-Yellow/peripherals/zephyr/soc/ambiq/Kconfig"
osource "/home/mnguyen4000/CSSE4011-Vulcan-Yellow/peripherals/zephyr/soc/altr/zephyr_nios2f/Kconfig"
osource "/home/mnguyen4000/CSSE4011-Vulcan-Yellow/peripherals/zephyr/soc/altr/qemu_nios2/Kconfig"
```
