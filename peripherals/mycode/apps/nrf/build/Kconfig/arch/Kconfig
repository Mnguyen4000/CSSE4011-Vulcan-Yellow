## peripherals/mycode/apps/nrf/build/Kconfig/soc/Kconfig.sysbuild
```kconfig
# Load SoC sysbuild Kconfig descriptions.
osource "/home/mnguyen4000/CSSE4011-Vulcan-Yellow/peripherals/zephyr/soc/xlnx/zynqmp/Kconfig.sysbuild"
osource "/home/mnguyen4000/CSSE4011-Vulcan-Yellow/peripherals/zephyr/soc/xlnx/zynq7000/Kconfig.sysbuild"
osource "/home/mnguyen4000/CSSE4011-Vulcan-Yellow/peripherals/zephyr/soc/xen/Kconfig.sysbuild"
osource "/home/mnguyen4000/CSSE4011-Vulcan-Yellow/peripherals/zephyr/soc/ti/simplelink/Kconfig.sysbuild"
osource "/home/mnguyen4000/CSSE4011-Vulcan-Yellow/peripherals/zephyr/soc/ti/lm3s6965/Kconfig.sysbuild"
osource "/home/mnguyen4000/CSSE4011-Vulcan-Yellow/peripherals/zephyr/soc/ti/k3/Kconfig.sysbuild"
osource "/home/mnguyen4000/CSSE4011-Vulcan-Yellow/peripherals/zephyr/soc/telink/tlsr/Kconfig.sysbuild"
osource "/home/mnguyen4000/CSSE4011-Vulcan-Yellow/peripherals/zephyr/soc/starfive/jh71xx/Kconfig.sysbuild"
osource "/home/mnguyen4000/CSSE4011-Vulcan-Yellow/peripherals/zephyr/soc/st/stm32/Kconfig.sysbuild"
osource "/home/mnguyen4000/CSSE4011-Vulcan-Yellow/peripherals/zephyr/soc/snps/qemu_arc/Kconfig.sysbuild"
osource "/home/mnguyen4000/CSSE4011-Vulcan-Yellow/peripherals/zephyr/soc/snps/nsim/Kconfig.sysbuild"
osource "/home/mnguyen4000/CSSE4011-Vulcan-Yellow/peripherals/zephyr/soc/snps/hsdk4xd/Kconfig.sysbuild"
osource "/home/mnguyen4000/CSSE4011-Vulcan-Yellow/peripherals/zephyr/soc/snps/hsdk/Kconfig.sysbuild"
osource "/home/mnguyen4000/CSSE4011-Vulcan-Yellow/peripherals/zephyr/soc/snps/emsk/Kconfig.sysbuild"
osource "/home/mnguyen4000/CSSE4011-Vulcan-Yellow/peripherals/zephyr/soc/snps/emsdp/Kconfig.sysbuild"
osource "/home/mnguyen4000/CSSE4011-Vulcan-Yellow/peripherals/zephyr/soc/snps/arc_iot/Kconfig.sysbuild"
osource "/home/mnguyen4000/CSSE4011-Vulcan-Yellow/peripherals/zephyr/soc/silabs/Kconfig.sysbuild"
osource "/home/mnguyen4000/CSSE4011-Vulcan-Yellow/peripherals/zephyr/soc/sifive/sifive_freedom/Kconfig.sysbuild"
osource "/home/mnguyen4000/CSSE4011-Vulcan-Yellow/peripherals/zephyr/soc/rockchip/Kconfig.sysbuild"
osource "/home/mnguyen4000/CSSE4011-Vulcan-Yellow/peripherals/zephyr/soc/renode/riscv_virtual/Kconfig.sysbuild"
osource "/home/mnguyen4000/CSSE4011-Vulcan-Yellow/peripherals/zephyr/soc/renesas/smartbond/Kconfig.sysbuild"
osource "/home/mnguyen4000/CSSE4011-Vulcan-Yellow/peripherals/zephyr/soc/renesas/rzt2m/Kconfig.sysbuild"
osource "/home/mnguyen4000/CSSE4011-Vulcan-Yellow/peripherals/zephyr/soc/renesas/rcar/Kconfig.sysbuild"
osource "/home/mnguyen4000/CSSE4011-Vulcan-Yellow/peripherals/zephyr/soc/renesas/ra/Kconfig.sysbuild"
osource "/home/mnguyen4000/CSSE4011-Vulcan-Yellow/peripherals/zephyr/soc/raspberrypi/Kconfig.sysbuild"
osource "/home/mnguyen4000/CSSE4011-Vulcan-Yellow/peripherals/zephyr/soc/quicklogic/eos_s3/Kconfig.sysbuild"
osource "/home/mnguyen4000/CSSE4011-Vulcan-Yellow/peripherals/zephyr/soc/qemu/virt_riscv/Kconfig.sysbuild"
osource "/home/mnguyen4000/CSSE4011-Vulcan-Yellow/peripherals/zephyr/soc/qemu/malta/Kconfig.sysbuild"
osource "/home/mnguyen4000/CSSE4011-Vulcan-Yellow/peripherals/zephyr/soc/openisa/rv32m1/Kconfig.sysbuild"
osource "/home/mnguyen4000/CSSE4011-Vulcan-Yellow/peripherals/zephyr/soc/nxp/s32/Kconfig.sysbuild"
osource "/home/mnguyen4000/CSSE4011-Vulcan-Yellow/peripherals/zephyr/soc/nxp/rw/Kconfig.sysbuild"
osource "/home/mnguyen4000/CSSE4011-Vulcan-Yellow/peripherals/zephyr/soc/nxp/mcx/Kconfig.sysbuild"
osource "/home/mnguyen4000/CSSE4011-Vulcan-Yellow/peripherals/zephyr/soc/nxp/lpc/Kconfig.sysbuild"
osource "/home/mnguyen4000/CSSE4011-Vulcan-Yellow/peripherals/zephyr/soc/nxp/layerscape/Kconfig.sysbuild"
osource "/home/mnguyen4000/CSSE4011-Vulcan-Yellow/peripherals/zephyr/soc/nxp/kinetis/Kconfig.sysbuild"
osource "/home/mnguyen4000/CSSE4011-Vulcan-Yellow/peripherals/zephyr/soc/nxp/imxrt/Kconfig.sysbuild"
osource "/home/mnguyen4000/CSSE4011-Vulcan-Yellow/peripherals/zephyr/soc/nxp/imx/Kconfig.sysbuild"
osource "/home/mnguyen4000/CSSE4011-Vulcan-Yellow/peripherals/zephyr/soc/nuvoton/numicro/Kconfig.sysbuild"
osource "/home/mnguyen4000/CSSE4011-Vulcan-Yellow/peripherals/zephyr/soc/nuvoton/numaker/Kconfig.sysbuild"
osource "/home/mnguyen4000/CSSE4011-Vulcan-Yellow/peripherals/zephyr/soc/nuvoton/npcx/Kconfig.sysbuild"
osource "/home/mnguyen4000/CSSE4011-Vulcan-Yellow/peripherals/zephyr/soc/nordic/Kconfig.sysbuild"
osource "/home/mnguyen4000/CSSE4011-Vulcan-Yellow/peripherals/zephyr/soc/neorv32/Kconfig.sysbuild"
osource "/home/mnguyen4000/CSSE4011-Vulcan-Yellow/peripherals/zephyr/soc/native/inf_clock/Kconfig.sysbuild"
osource "/home/mnguyen4000/CSSE4011-Vulcan-Yellow/peripherals/zephyr/soc/microchip/miv/Kconfig.sysbuild"
osource "/home/mnguyen4000/CSSE4011-Vulcan-Yellow/peripherals/zephyr/soc/microchip/mec/Kconfig.sysbuild"
osource "/home/mnguyen4000/CSSE4011-Vulcan-Yellow/peripherals/zephyr/soc/lowrisc/opentitan/Kconfig.sysbuild"
osource "/home/mnguyen4000/CSSE4011-Vulcan-Yellow/peripherals/zephyr/soc/litex/litex_vexriscv/Kconfig.sysbuild"
osource "/home/mnguyen4000/CSSE4011-Vulcan-Yellow/peripherals/zephyr/soc/ite/ec/Kconfig.sysbuild"
osource "/home/mnguyen4000/CSSE4011-Vulcan-Yellow/peripherals/zephyr/soc/intel/raptor_lake/Kconfig.sysbuild"
osource "/home/mnguyen4000/CSSE4011-Vulcan-Yellow/peripherals/zephyr/soc/intel/lakemont/Kconfig.sysbuild"
osource "/home/mnguyen4000/CSSE4011-Vulcan-Yellow/peripherals/zephyr/soc/intel/intel_socfpga_std/Kconfig.sysbuild"
osource "/home/mnguyen4000/CSSE4011-Vulcan-Yellow/peripherals/zephyr/soc/intel/intel_socfpga/Kconfig.sysbuild"
osource "/home/mnguyen4000/CSSE4011-Vulcan-Yellow/peripherals/zephyr/soc/intel/intel_niosv/Kconfig.sysbuild"
osource "/home/mnguyen4000/CSSE4011-Vulcan-Yellow/peripherals/zephyr/soc/intel/intel_ish/Kconfig.sysbuild"
osource "/home/mnguyen4000/CSSE4011-Vulcan-Yellow/peripherals/zephyr/soc/intel/intel_adsp/Kconfig.sysbuild"
osource "/home/mnguyen4000/CSSE4011-Vulcan-Yellow/peripherals/zephyr/soc/intel/elkhart_lake/Kconfig.sysbuild"
osource "/home/mnguyen4000/CSSE4011-Vulcan-Yellow/peripherals/zephyr/soc/intel/atom/Kconfig.sysbuild"
osource "/home/mnguyen4000/CSSE4011-Vulcan-Yellow/peripherals/zephyr/soc/intel/apollo_lake/Kconfig.sysbuild"
osource "/home/mnguyen4000/CSSE4011-Vulcan-Yellow/peripherals/zephyr/soc/intel/alder_lake/Kconfig.sysbuild"
osource "/home/mnguyen4000/CSSE4011-Vulcan-Yellow/peripherals/zephyr/soc/infineon/xmc/Kconfig.sysbuild"
osource "/home/mnguyen4000/CSSE4011-Vulcan-Yellow/peripherals/zephyr/soc/gd/gd32/Kconfig.sysbuild"
osource "/home/mnguyen4000/CSSE4011-Vulcan-Yellow/peripherals/zephyr/soc/gaisler/leon3/Kconfig.sysbuild"
osource "/home/mnguyen4000/CSSE4011-Vulcan-Yellow/peripherals/zephyr/soc/gaisler/gr716a/Kconfig.sysbuild"
osource "/home/mnguyen4000/CSSE4011-Vulcan-Yellow/peripherals/zephyr/soc/espressif/Kconfig.sysbuild"
osource "/home/mnguyen4000/CSSE4011-Vulcan-Yellow/peripherals/zephyr/soc/ene/kb1200/Kconfig.sysbuild"
osource "/home/mnguyen4000/CSSE4011-Vulcan-Yellow/peripherals/zephyr/soc/efinix/sapphire/Kconfig.sysbuild"
osource "/home/mnguyen4000/CSSE4011-Vulcan-Yellow/peripherals/zephyr/soc/cypress/Kconfig.sysbuild"
osource "/home/mnguyen4000/CSSE4011-Vulcan-Yellow/peripherals/zephyr/soc/cdns/xtensa_sample_controller/Kconfig.sysbuild"
osource "/home/mnguyen4000/CSSE4011-Vulcan-Yellow/peripherals/zephyr/soc/cdns/dc233c/Kconfig.sysbuild"
osource "/home/mnguyen4000/CSSE4011-Vulcan-Yellow/peripherals/zephyr/soc/brcm/bcmvk/Kconfig.sysbuild"
osource "/home/mnguyen4000/CSSE4011-Vulcan-Yellow/peripherals/zephyr/soc/brcm/bcm2712/Kconfig.sysbuild"
osource "/home/mnguyen4000/CSSE4011-Vulcan-Yellow/peripherals/zephyr/soc/brcm/bcm2711/Kconfig.sysbuild"
osource "/home/mnguyen4000/CSSE4011-Vulcan-Yellow/peripherals/zephyr/soc/atmel/sam0/Kconfig.sysbuild"
osource "/home/mnguyen4000/CSSE4011-Vulcan-Yellow/peripherals/zephyr/soc/atmel/sam/Kconfig.sysbuild"
osource "/home/mnguyen4000/CSSE4011-Vulcan-Yellow/peripherals/zephyr/soc/aspeed/Kconfig.sysbuild"
osource "/home/mnguyen4000/CSSE4011-Vulcan-Yellow/peripherals/zephyr/soc/arm/Kconfig.sysbuild"
osource "/home/mnguyen4000/CSSE4011-Vulcan-Yellow/peripherals/zephyr/soc/arm/beetle/Kconfig.sysbuild"
osource "/home/mnguyen4000/CSSE4011-Vulcan-Yellow/peripherals/zephyr/soc/andestech/Kconfig.sysbuild"
osource "/home/mnguyen4000/CSSE4011-Vulcan-Yellow/peripherals/zephyr/soc/ambiq/Kconfig.sysbuild"
osource "/home/mnguyen4000/CSSE4011-Vulcan-Yellow/peripherals/zephyr/soc/altr/zephyr_nios2f/Kconfig.sysbuild"
osource "/home/mnguyen4000/CSSE4011-Vulcan-Yellow/peripherals/zephyr/soc/altr/qemu_nios2/Kconfig.sysbuild"
```
